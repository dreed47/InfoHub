## main/Kconfig.projbuild
```kconfig
menu "InfoHub"

    config INFOHUB_PLUGIN_PRINTER
        bool "Enable printer plugin (Bambu Lab cloud/local MQTT status)"
        default y
        help
            Enables the printer plugin: Bambu Cloud + local MQTT connectivity,
            AMS/filament display, print status dashboard, camera preview, and
            the printer-selector home screen. This is InfoHub's original,
            flagship feature and is enabled by default. Disable it to build a
            printer-free info-display firmware (e.g. weather/stocks only) —
            all printer-specific code, TLS trust anchors, and MQTT/JPEG
            dependencies are compiled out entirely.

    config INFOHUB_PLUGIN_TEMPEST
        bool "Enable Tempest plugin (WeatherFlow Tempest cloud API)"
        default n
        help
            Enables the Tempest plugin: fetches current conditions and an
            hourly forecast from a WeatherFlow Tempest weather station via
            WeatherFlow's cloud REST API (station ID + personal API token,
            entered in Web Config). Adds a "Tempest" card to Web Config plus
            a 2-page on-device display screen (current conditions + hourly
            forecast). For owners of an actual WeatherFlow Tempest station
            specifically — see INFOHUB_PLUGIN_GEOWEATHER for a generic,
            no-hardware-required weather plugin. Disabled by default to keep
            flash/RAM budget down on builds that don't want it.

    config INFOHUB_PLUGIN_STOCKS
        bool "Enable stocks plugin (Alpha Vantage cloud API)"
        default n
        help
            Enables the stocks plugin: fetches quotes for up to 4 tracked
            ticker symbols from Alpha Vantage's cloud REST API (personal API
            key, entered in Web Config). Adds a "Stocks" card to Web Config
            and a display screen showing each symbol's price with a colored
            circle (green up / red down for the day). Free-tier Alpha
            Vantage accounts are capped at 25 requests/day, so quotes poll
            infrequently (hours, not minutes) and free-tier data itself only
            refreshes once per trading day. Disabled by default to keep
            flash/RAM budget down on builds that don't want it.

    config INFOHUB_PLUGIN_GEOWEATHER
        bool "Enable geoweather plugin (Open-Meteo city/location weather, no API key)"
        default n
        help
            Enables the geoweather plugin: fetches current conditions and an
            hourly forecast for a free-text location (e.g. "Austin, TX") via
            Open-Meteo's free geocoding + forecast REST APIs -- no API key or
            account required. Adds a "Weather" card to Web Config and a
            2-page on-device display screen (current conditions + hourly
            forecast). This is the general-purpose weather plugin most users
            want; the separate Tempest plugin (INFOHUB_PLUGIN_TEMPEST) is for
            owners of an actual WeatherFlow Tempest station specifically.
            Disabled by default to keep flash/RAM budget down on builds that
            don't want it.

    config INFOHUB_EXPERIMENTAL_PRINT_CONTROL
        bool "Enable experimental print control buttons (Pause/Resume/Stop)"
        default n
        depends on INFOHUB_PLUGIN_PRINTER
        help
            Enables on-display Pause/Resume/Stop buttons on the cloud preview
            page (page2). When disabled (default), the cover image is shown at
            its original full size and no print-control widgets are created.

            BACKGROUND: Bambu Lab printers reject Pause/Resume/Stop MQTT
            commands that are not signed by the proprietary Bambu Studio
            network plugin. With this option enabled, the firmware will still
            publish the command, but the printer may silently drop it. Use of
            any mechanism to make the printer accept the command is left to
            the integrator and is NOT included in this firmware. Enabling this
            option carries potential legal exposure depending on jurisdiction
            (Bambu has issued cease-and-desist notices over related projects).
            Use at your own risk.

endmenu
```
